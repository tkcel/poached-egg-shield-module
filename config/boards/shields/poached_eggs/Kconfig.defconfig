## config/boards/shields/poached_eggs/Kconfig.defconfig
```kconfig
if SHIELD_POACHED_EGGS_LEFT

config ZMK_KEYBOARD_NAME
    default "Poached Eggs"

config ZMK_SPLIT_ROLE_CENTRAL
    default y

config ZMK_SPLIT_BLE_CENTRAL_BATTERY_LEVEL_FETCHING
    default y

config ZMK_SPLIT_BLE_CENTRAL_BATTERY_LEVEL_PROXY
    default y

endif

if SHIELD_POACHED_EGGS_LEFT || SHIELD_POACHED_EGGS_RIGHT

config ZMK_SPLIT
    default y

endif
```
